## package/atemsys/Config.in
```kconfig
comment "atemsys needs a Linux kernel to be built"
	depends on !BR2_LINUX_KERNEL

config BR2_PACKAGE_ATEMSYS
	bool "atemsys"
	depends on BR2_LINUX_KERNEL
	help
	  Atemsys for Linux.

	  http://www.acontis.com/eng/products/downloads/ethercat-for-ti-processors.html
```

## package/etherlab/Config.in
```kconfig
comment "igh-ethercat needs a Linux kernel to be built"
	depends on !BR2_LINUX_KERNEL

config BR2_PACKAGE_ETHERLAB
	bool "igh-ethercat"
	depends on BR2_LINUX_KERNEL
	help
	  IgH EtherCAT Master for Linux.

	  http://www.etherlab.org/en/ethercat/index.php

if BR2_PACKAGE_ETHERLAB

config BR2_PACKAGE_ETHERLAB_GENERIC
	bool "generic driver"

config BR2_PACKAGE_ETHERLAB_8139TOO
	bool "8139too driver"

config BR2_PACKAGE_ETHERLAB_E100
	bool "e100 driver"

config BR2_PACKAGE_ETHERLAB_E1000
	bool "e1000 driver"

config BR2_PACKAGE_ETHERLAB_E1000E
	bool "e1000e driver"

config BR2_PACKAGE_ETHERLAB_R8169
	bool "r8169 driver"

endif
```

## package/rtl8812AU/Config.in
```kconfig
comment "rtl8812AU needs a Linux kernel to be built"
	depends on !BR2_LINUX_KERNEL

config BR2_PACKAGE_RTL8812AU
	bool "rtl8812AU"
	depends on BR2_LINUX_KERNEL
	help
	  rtl8812AU WiFi support for Linux.
```
